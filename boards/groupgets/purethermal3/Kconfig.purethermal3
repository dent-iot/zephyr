## boards/groupgets/purethermal3/Kconfig.purethermal3
```kconfig
# Copyright (c) 2026 David van Rijn Dent-Iot
# SPDX-License-Identifier: Apache-2.0

config BOARD_PURETHERMAL3
	select SOC_STM32F412ZX
```

## boards/groupgets/purethermal3/board.yml
```yaml
board:
  name: purethermal3
  full_name: PURETHERMAL 3
  vendor: groupgets
  socs:
    - name: stm32f412zx
```

## drivers/pulse_io/Kconfig.stm32
```kconfig
# Copyright (c) 2026 Dent IoT
# SPDX-License-Identifier: Apache-2.0

config PULSE_IO_STM32_TIMER
	bool "STM32 Pulse IO backend (timer + 2x DMA to GPIO/ARR)"
	default y
	depends on DT_HAS_ST_STM32_TIMER_PULSE_IO_ENABLED
	select DMA
	select GPIO
	help
	  Pulse IO backend for STM32 (SYMBOL mode) that generates timed edges
	  on an arbitrary GPIO pin. Each timer update event triggers one DMA
	  word on two streams: a circular 2-word pattern to the GPIO port's
	  BSRR register (toggling the pin per period) and a linear per-symbol
	  word to the timer's ARR register (setting each period's length).
```
